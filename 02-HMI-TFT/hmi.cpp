// HMI - Arduino Uno + TFT tactil 2.4" (MCUFRIEND)
// Este Arduino NO decide nada de negocio (saldo, validaciones, etc).
// Solo dibuja lo que el ESP32 le manda por Serial (protocolo EST:...) y le
// avisa que boton tocaron (TOQUE:<n>). El ESP32 es quien manda.
//
// Conexion: Serial por defecto (pines 0/1, TX/RX) hacia el ESP32 (Serial2).
// Por eso mientras esto corre no se puede usar el Monitor Serie del Arduino
// para debug: el puerto esta ocupado por la comunicacion con el ESP32.
#include <Adafruit_GFX.h>
#include <MCUFRIEND_kbv.h>
#include <TouchScreen.h>

// PINES TACTILES Y CALIBRACION (igual que la prueba anterior)
#define YP A1
#define XM A2
#define YM 7
#define XP 6

#define TS_MINX 150
#define TS_MAXX 920
#define TS_MINY 120
#define TS_MAXY 940
#define MINPRESSURE 5
#define MAXPRESSURE 1000

TouchScreen ts = TouchScreen(XP, YP, XM, YM, 300);
MCUFRIEND_kbv tft;

// PALETA DE COLORES
#define BLACK     0x0000
#define BLUE      0x001F
#define RED       0xF800
#define GREEN     0x07E0
#define CYAN      0x07FF
#define YELLOW    0xFFE0
#define WHITE     0xFFFF
#define NAVY      0x000F
#define DARKGRAY  0x39E7

// BITMAP QR (128x128) - Wifi ESP32-DEV, generado en Python con la libreria qrcode
// Contenido codificado: WIFI:S:ESP32-DEV;T:WPA;P:1234567890;;
const unsigned char epd_bitmap_qr_code_wifi[] PROGMEM = {
  0xff, 0xff, 0xff, 0xff, 0xff, 0xff, 0xff, 0xff, 0xff, 0xff, 0xff, 0xff, 0xff, 0xff, 0xff, 0xff, 
  0xff, 0xff, 0xff, 0xff, 0xff, 0xff, 0xff, 0xff, 0xff, 0xff, 0xff, 0xff, 0xff, 0xff, 0xff, 0xff, 
  0xff, 0xff, 0xff, 0xff, 0xff, 0xff, 0xff, 0xff, 0xff, 0xff, 0xff, 0xff, 0xff, 0xff, 0xff, 0xff, 
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  0xff, 0xff, 0xff, 0xff, 0xff, 0xff, 0xff, 0xff, 0xff, 0xff, 0xff, 0xff, 0xff, 0xff, 0xff, 0xff, 
};

// ESTADO "DE PANTALLA" (solo para saber que dibujar, no decide nada)
enum Pantalla {
  P_NINGUNA,
  P_REPOSO,
  P_QR_ESPERA,
  P_QR_PAGANDO,
  P_PAGO_EXITOSO,
  P_MONEDA_INGRESO,
  P_SEL_PROD,
  P_SEL_VOL,
  P_CONFIRMACION,
  P_DISPENSANDO,
  P_FINALIZADO,
  P_SLEEP
};

Pantalla pantallaActual = P_NINGUNA;

// Cache de los ultimos datos recibidos (para redibujar en SALDO: sin duplicar logica)
int  gSaldo = 0;
int  gProd  = 0;
int  gVol   = 0;
int  gCosto = 0;
char gMascara[4] = "111";

unsigned long ultimoToque = 0;
const unsigned long DEBOUNCE_MS = 300;

// ZONAS TACTILES ACTIVAS (definidas por cada pantalla, btn = lo que se
// manda de vuelta al ESP32; debe coincidir exacto con lo que main.cpp espera)
struct BotonUI { int x, y, w, h, btn; };
BotonUI botones[4];
int numBotones = 0;

void limpiarBotones() { numBotones = 0; }

void agregarBoton(int x, int y, int w, int h, int btn, uint16_t colorFondo, uint16_t colorTexto, const char* texto) {
  botones[numBotones].x = x; botones[numBotones].y = y;
  botones[numBotones].w = w; botones[numBotones].h = h;
  botones[numBotones].btn = btn;
  numBotones++;

  tft.fillRect(x, y, w, h, colorFondo);
  tft.drawRect(x, y, w, h, WHITE);
  tft.setTextColor(colorTexto);
  tft.setTextSize(2);

  int16_t x1, y1;
  uint16_t textW, textH;
  tft.getTextBounds(texto, 0, 0, &x1, &y1, &textW, &textH);
  tft.setCursor(x + (w - textW) / 2, y + (h - textH) / 2);
  tft.print(texto);
}

// PROTOTIPOS
void procesarToque(int x, int y);
void leerSerialESP32();
void procesarLinea(char* linea);
void enviarToque(int btn);
void encabezado();
void dibujarReposo();
void dibujarQrEspera();
void dibujarQrPagando();
void dibujarPagoExitoso();
void dibujarMonedaIngreso();
void dibujarSelProd();
void dibujarSelVol();
void dibujarConfirmacion();
void dibujarDispensando();
void dibujarFinalizado();
void dibujarSaldoInsuficiente();
void dibujarSleep();
void redibujarPantallaActual();

// SETUP
void setup() {
  Serial.begin(9600); // hacia el ESP32 (Serial2 del otro lado), sin debug USB en paralelo

  uint16_t ID = tft.readID();
  if (ID == 0xD3D3) ID = 0x9341;
  tft.begin(ID);
  tft.setRotation(1);

  dibujarReposo(); // pantalla local de arranque, se corrige apenas llegue la respuesta
  Serial.println(F("SYNC")); // pide el estado real al ESP32 (por si ya venia en otra pantalla)
}

// LOOP PRINCIPAL
void loop() {
  TSPoint p = ts.getPoint();
  pinMode(XM, OUTPUT);
  pinMode(YP, OUTPUT);

  if (p.z > MINPRESSURE && p.z < MAXPRESSURE) {
    if (millis() - ultimoToque > DEBOUNCE_MS) {
      ultimoToque = millis();
      int touchX = map(p.y, TS_MINY, TS_MAXY, 320, 0);
      int touchY = map(p.x, TS_MINX, TS_MAXX, 240, 0);
      procesarToque(touchX, touchY);
    }
  }

  leerSerialESP32();
}

// TOQUES -> se manda el boton, el ESP32 decide que hacer
void procesarToque(int x, int y) {
  for (int i = 0; i < numBotones; i++) {
    BotonUI &b = botones[i];
    if (x >= b.x && x <= b.x + b.w && y >= b.y && y <= b.y + b.h) {
      enviarToque(b.btn);
      return;
    }
  }
}

void enviarToque(int btn) {
  Serial.print(F("TOQUE:"));
  Serial.println(btn);
}

// LECTURA SERIAL DEL ESP32 (sin String, para no fragmentar el heap del Uno)
void leerSerialESP32() {
  static char buf[48];
  static uint8_t idx = 0;

  while (Serial.available() > 0) {
    char c = Serial.read();
    if (c == '\n') {
      buf[idx] = '\0';
      procesarLinea(buf);
      idx = 0;
    } else if (c != '\r' && idx < sizeof(buf) - 1) {
      buf[idx++] = c;
    }
  }
}

void procesarLinea(char* linea) {
  if (strncmp(linea, "EST:", 4) == 0) {
    char* resto = linea + 4;
    char* tok = strtok(resto, ":");
    if (tok == nullptr) return;

    if (strcmp(tok, "REPOSO") == 0) {
      if (pantallaActual != P_REPOSO) { pantallaActual = P_REPOSO; dibujarReposo(); }

    } else if (strcmp(tok, "QR_ESPERA") == 0) {
      if (pantallaActual != P_QR_ESPERA) { pantallaActual = P_QR_ESPERA; dibujarQrEspera(); }

    } else if (strcmp(tok, "QR_PAGANDO") == 0) {
      if (pantallaActual != P_QR_PAGANDO) { pantallaActual = P_QR_PAGANDO; dibujarQrPagando(); }

    } else if (strcmp(tok, "PAGO_EXITOSO") == 0) {
      gProd = atoi(strtok(NULL, ":"));
      gVol  = atoi(strtok(NULL, ":"));
      gCosto = atoi(strtok(NULL, ":"));
      if (pantallaActual != P_PAGO_EXITOSO) { pantallaActual = P_PAGO_EXITOSO; dibujarPagoExitoso(); }

    } else if (strcmp(tok, "MONEDA_INGRESO") == 0) {
      gSaldo = atoi(strtok(NULL, ":"));
      if (pantallaActual != P_MONEDA_INGRESO) { pantallaActual = P_MONEDA_INGRESO; dibujarMonedaIngreso(); }

    } else if (strcmp(tok, "SEL_PROD") == 0) {
      gSaldo = atoi(strtok(NULL, ":"));
      char* mask = strtok(NULL, ":");
      if (mask != nullptr) strncpy(gMascara, mask, 3);
      if (pantallaActual != P_SEL_PROD) { pantallaActual = P_SEL_PROD; dibujarSelProd(); }

    } else if (strcmp(tok, "SEL_VOL") == 0) {
      gProd  = atoi(strtok(NULL, ":"));
      gSaldo = atoi(strtok(NULL, ":"));
      if (pantallaActual != P_SEL_VOL) { pantallaActual = P_SEL_VOL; dibujarSelVol(); }

    } else if (strcmp(tok, "CONFIRMACION") == 0) {
      gProd  = atoi(strtok(NULL, ":"));
      gVol   = atoi(strtok(NULL, ":"));
      gCosto = atoi(strtok(NULL, ":"));
      gSaldo = atoi(strtok(NULL, ":"));
      if (pantallaActual != P_CONFIRMACION) { pantallaActual = P_CONFIRMACION; dibujarConfirmacion(); }

    } else if (strcmp(tok, "DISPENSANDO") == 0) {
      if (pantallaActual != P_DISPENSANDO) { pantallaActual = P_DISPENSANDO; dibujarDispensando(); }

    } else if (strcmp(tok, "FINALIZADO") == 0) {
      gCosto = atoi(strtok(NULL, ":"));
      if (pantallaActual != P_FINALIZADO) { pantallaActual = P_FINALIZADO; dibujarFinalizado(); }

    } else if (strcmp(tok, "SLEEP") == 0) {
      if (pantallaActual != P_SLEEP) { pantallaActual = P_SLEEP; dibujarSleep(); }

    } else if (strcmp(tok, "SALDO_INSUF") == 0) {
      dibujarSaldoInsuficiente(); // aviso puntual, no cambia de pantalla
    }
  } else if (strncmp(linea, "SALDO:", 6) == 0) {
    gSaldo = atoi(linea + 6);
    // Solo tiene sentido refrescar el saldo en estas 4 pantallas
    if (pantallaActual == P_MONEDA_INGRESO || pantallaActual == P_SEL_PROD ||
        pantallaActual == P_SEL_VOL || pantallaActual == P_CONFIRMACION) {
      redibujarPantallaActual();
    }
  }
}

void redibujarPantallaActual() {
  switch (pantallaActual) {
    case P_MONEDA_INGRESO: dibujarMonedaIngreso(); break;
    case P_SEL_PROD:       dibujarSelProd(); break;
    case P_SEL_VOL:        dibujarSelVol(); break;
    case P_CONFIRMACION:   dibujarConfirmacion(); break;
    default: break;
  }
}

// ENCABEZADO COMUN
void encabezado() {
  tft.fillRect(0, 0, 320, 35, NAVY);
  tft.drawRect(0, 0, 320, 35, WHITE);
  tft.setCursor(50, 8);
  tft.setTextColor(WHITE);
  tft.setTextSize(2);
  tft.print(F("DISPENSADORA"));
}

// PANTALLAS
// btn 1 = arriba-izq, 2 = arriba-der, 3 = abajo-izq, 4 = abajo-der (por
// convencion, aunque cada pantalla puede usar solo los que necesite)
void dibujarReposo() {
  tft.fillScreen(BLACK);
  encabezado();
  limpiarBotones();

  tft.setCursor(30, 42);
  tft.setTextColor(YELLOW);
  tft.setTextSize(2);
  tft.print(F("ELIJA METODO DE PAGO"));

  agregarBoton(10, 60, 140, 75, 1, BLUE, WHITE, "PAGO QR");
  agregarBoton(170, 60, 140, 75, 2, GREEN, BLACK, "MONEDA");
}

void dibujarQrEspera() {
  tft.fillScreen(BLACK);
  encabezado();
  limpiarBotones();

  tft.setCursor(80, 40);
  tft.setTextColor(CYAN);
  tft.setTextSize(2);
  tft.print(F("ESCANEE EL QR"));

  tft.fillRect(92, 58, 136, 136, WHITE);
  // DESPUES (nombre nuevo, coincide con el array que generamos)
  tft.drawBitmap(96, 62, epd_bitmap_qr_code_wifi, 128, 128, BLACK, WHITE);
 

  // Solo boton 4 (cancelar): es el unico que el ESP32 escucha en este estado
  agregarBoton(90, 200, 140, 35, 4, RED, WHITE, "CANCELAR");
}

void dibujarQrPagando() {
  tft.fillScreen(BLACK);
  encabezado();
  limpiarBotones(); // sin botones, se resuelve solo (5s) del lado del ESP32

  tft.setCursor(30, 90);
  tft.setTextColor(CYAN);
  tft.setTextSize(2);
  tft.print(F("PROCESANDO PAGO"));

  tft.setCursor(40, 130);
  tft.setTextColor(WHITE);
  tft.setTextSize(2);
  tft.print(F("ESPERE UN MOMENTO..."));
}

void dibujarPagoExitoso() {
  tft.fillScreen(BLACK);
  encabezado();
  limpiarBotones(); // sin botones: lo dispensa el pulsador fisico de la boquilla

  tft.setCursor(30, 45);
  tft.setTextColor(GREEN);
  tft.setTextSize(2);
  tft.print(F("PAGO EXITOSO"));

  tft.setCursor(10, 90);
  tft.setTextColor(WHITE);
  tft.setTextSize(2);
  tft.print(F("Presione la boquilla"));
  tft.setCursor(10, 115);
  tft.print(F("del producto "));
  tft.print(gProd);

  tft.setCursor(10, 150);
  tft.setTextColor(YELLOW);
  tft.print(F("Total: Bs. "));
  tft.print(gCosto);
}

void dibujarMonedaIngreso() {
  tft.fillScreen(BLACK);
  encabezado();
  limpiarBotones();

  tft.setCursor(10, 45);
  tft.setTextColor(YELLOW);
  tft.setTextSize(2);
  tft.print(F("SALDO: Bs. "));
  tft.print(gSaldo);

  tft.setCursor(10, 75);
  tft.setTextColor(WHITE);
  tft.setTextSize(2);
  tft.print(F("Inserte monedas..."));

  if (gSaldo > 0) {
    agregarBoton(90, 160, 140, 45, 4, GREEN, BLACK, "COMPRAR");
  } else {
    agregarBoton(90, 160, 140, 45, 4, RED, WHITE, "SALIR");
  }
}

void dibujarSelProd() {
  tft.fillScreen(BLACK);
  encabezado();
  limpiarBotones();

  tft.setCursor(10, 40);
  tft.setTextColor(YELLOW);
  tft.setTextSize(2);
  tft.print(F("SALDO: Bs. "));
  tft.print(gSaldo);

  const char* nombres[3] = {"PROD 1", "PROD 2", "PROD 3"};
  for (int i = 0; i < 3; i++) {
    bool disponible = (gMascara[i] == '1');
    uint16_t color = disponible ? BLUE : DARKGRAY;
    const char* txt = disponible ? nombres[i] : "AGOTADO";
    int x = (i < 2) ? (i == 0 ? 10 : 170) : 10;
    int y = (i < 2) ? 60 : 145;
    agregarBoton(x, y, 140, 75, i + 1, color, WHITE, txt);
  }
  agregarBoton(170, 145, 140, 75, 4, RED, WHITE, "ATRAS");
}

void dibujarSelVol() {
  tft.fillScreen(BLACK);
  encabezado();
  limpiarBotones();

  tft.setCursor(10, 40);
  tft.setTextColor(YELLOW);
  tft.setTextSize(2);
  tft.print(F("PROD P"));
  tft.print(gProd);
  tft.print(F("  SALDO: Bs. "));
  tft.print(gSaldo);

  agregarBoton(10, 60, 140, 75, 1, BLUE, WHITE, "0.5 L");
  agregarBoton(170, 60, 140, 75, 2, BLUE, WHITE, "1 L");
  agregarBoton(10, 145, 140, 75, 3, BLUE, WHITE, "2 L");
  agregarBoton(170, 145, 140, 75, 4, RED, WHITE, "ATRAS");
}

void dibujarConfirmacion() {
  tft.fillScreen(BLACK);
  encabezado();
  limpiarBotones();

  tft.setCursor(10, 45);
  tft.setTextColor(WHITE);
  tft.setTextSize(2);
  tft.print(F("TOTAL: Bs. "));
  tft.print(gCosto);

  tft.setCursor(10, 75);
  tft.setTextColor(YELLOW);
  tft.print(F("SALDO: Bs. "));
  tft.print(gSaldo);

  // btn 1 = aceptar, btn 4 = cancelar (asi los espera el ESP32 en este estado)
  agregarBoton(10, 145, 140, 75, 1, GREEN, BLACK, "ACEPTAR");
  agregarBoton(170, 145, 140, 75, 4, RED, WHITE, "CANCELAR");
}

void dibujarDispensando() {
  tft.fillScreen(BLACK);
  encabezado();
  limpiarBotones();

  tft.setCursor(50, 90);
  tft.setTextColor(CYAN);
  tft.setTextSize(3);
  tft.print(F("DISPENSANDO"));

  tft.setCursor(40, 140);
  tft.setTextColor(WHITE);
  tft.setTextSize(2);
  tft.print(F("POR FAVOR ESPERE..."));
}

void dibujarFinalizado() {
  tft.fillScreen(BLACK);
  encabezado();
  limpiarBotones(); // el ESP32 vuelve solo a REPOSO/MONEDA en 5s

  tft.setCursor(60, 60);
  tft.setTextColor(GREEN);
  tft.setTextSize(3);
  tft.print(F("LISTO!"));

  tft.setCursor(20, 110);
  tft.setTextColor(WHITE);
  tft.setTextSize(2);
  tft.print(F("Retire su producto"));

  tft.setCursor(20, 145);
  tft.setTextColor(YELLOW);
  tft.print(F("Total: Bs. "));
  tft.print(gCosto);
}

void dibujarSaldoInsuficiente() {
  // Aviso corto encima de la pantalla actual (SEL_VOL). El ESP32 manda
  // enseguida el EST:SEL_VOL de nuevo, asi que no hace falta restaurar nada.
  tft.fillRect(10, 200, 300, 30, RED);
  tft.setCursor(20, 208);
  tft.setTextColor(WHITE);
  tft.setTextSize(2);
  tft.print(F("SALDO INSUFICIENTE"));
}

void dibujarSleep() {
  tft.fillScreen(BLACK);
  limpiarBotones(); // pantalla apagada, no escucha toques

  tft.setCursor(40, 110);
  tft.setTextColor(DARKGRAY);
  tft.setTextSize(2);
  tft.print(F("Presione el boton"));
  tft.setCursor(60, 135);
  tft.print(F("para In"));
}
